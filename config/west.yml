## config/west.yml
```yaml
manifest:
  remotes:
    - name: zmkfirmware
      url: https://github.com
    - name: elekit
      url: https://github.com
  projects:
    - name: zmk
      remote: zmkfirmware
      revision: main  # ★ここを最新（main）に強制固定し、最新のxiao_ble//zmkをシステムに認識させます
      import: app/west.yml
    - name: unified-zmk-config-template
      remote: elekit
      revision: main
  self:
    path: config
```
